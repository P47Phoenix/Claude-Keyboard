## claude-code-pad/firmware/zmk/boards/shields/claude_code_pad/Kconfig.defconfig
```kconfig
# Copyright (c) 2026 Claude Code Pad project
# SPDX-License-Identifier: MIT
#
# Shield-level defaults for the Claude Code Pad (XIAO nRF52840, 5x5 matrix,
# EC11 encoder, 25x SK6812MINI-E, PN532 NFC over TWI, VBAT/NTC SAADC).

if SHIELD_CLAUDE_CODE_PAD

config ZMK_KEYBOARD_NAME
	default "Claude Code Pad"

#
# -------- Power / brownout ------------------------------------------------
#
# Sleep timeout: 10 min idle -> deep-sleep to preserve cell capacity
# between Claude Code sessions. Undervolt cutoff is additionally enforced
# by the ccp_battery_guard driver (see claude_code_pad.conf).
#
config ZMK_IDLE_SLEEP_TIMEOUT
	default 600000

config ZMK_SLEEP
	default y

#
# -------- BLE multi-host --------------------------------------------------
#
# Three profiles keeps the keymap bindings tidy (BT_SEL 0/1/2) and still
# covers workstation + laptop + phone. Raising to 5 slots (BT_MAX_CONN)
# covers 3 active profiles + 1 LE shell + 1 headroom.
#
config BT_MAX_CONN
	default 5

config BT_MAX_PAIRED
	default 5

config ZMK_BLE
	default y

config ZMK_USB
	default y

#
# -------- RGB underglow ---------------------------------------------------
#
# CRITICAL: BRT_MAX is the firmware hard cap per IEC 62368-1 Annex Q.
#
# 25 LEDs x 60 mA full-white = 1500 mA peak (LDO rating 600 mA, Annex Q
# PS2 cap 300 mA).
# 300 mA / 25 LEDs = 12 mA average per LED.
# 12 mA / 60 mA(full) = 20 %. -> BRT_MAX = 20.
#
# Ordinary thermal conditions only. ccp_battery_guard derates this further
# on low VBAT, and ccp_thermal_guard hard-caps to BRT_MAX=7 (~100 mA total)
# when NTC_ADC is out-of-range per IEC 62368-1 Annex Q fallback rules.
#
# Keep START_BRT < BRT_MAX so boot does not momentarily exceed the cap.
#
config ZMK_RGB_UNDERGLOW
	default y

config ZMK_RGB_UNDERGLOW_BRT_MIN
	default 0

config ZMK_RGB_UNDERGLOW_BRT_MAX
	default 20

config ZMK_RGB_UNDERGLOW_BRT_START
	default 10

config ZMK_RGB_UNDERGLOW_BRT_STEP
	default 2

config ZMK_RGB_UNDERGLOW_ON_START
	default y

config ZMK_RGB_UNDERGLOW_AUTO_OFF_IDLE
	default y

config ZMK_RGB_UNDERGLOW_AUTO_OFF_USB
	default n

#
# -------- Matrix ----------------------------------------------------------
#
# 5x5 direct-wired through 1N4148W diodes (K->row). Rows are inputs, cols
# are the driven side. 5 ms debounce tracks the SK6812MINI frame period
# comfortably and is below the HID 8 ms polling floor.
#
config ZMK_KSCAN_DEBOUNCE_PRESS_MS
	default 5

config ZMK_KSCAN_DEBOUNCE_RELEASE_MS
	default 5

#
# -------- HID / USB -------------------------------------------------------
#
# ZMK_HID_REPORT_TYPE_NKRO is a Kconfig *choice* symbol; it cannot be
# selected or defaulted from a shield defconfig. Set it explicitly in
# claude_code_pad.conf where a plain `CONFIG_ZMK_HID_REPORT_TYPE_NKRO=y`
# picks the choice member.

endif # SHIELD_CLAUDE_CODE_PAD
```

## claude-code-pad/firmware/zmk/boards/shields/claude_code_pad/Kconfig.shield
```kconfig
# Copyright (c) 2026 Claude Code Pad project
# SPDX-License-Identifier: MIT

config SHIELD_CLAUDE_CODE_PAD
	def_bool $(shields_list_contains,claude_code_pad)
```

## claude-code-pad/firmware/zmk/config/west.yml
```yaml
# west manifest for the Claude Code Pad user build.
#
# Usage:
#   mkdir -p ~/zmk-ccp && cd ~/zmk-ccp
#   git clone https://github.com/<you>/Claude-Keyboard src/ccp
#   west init -l src/ccp/claude-code-pad/firmware/zmk/config
#   west update
#   west build -s zmk/app -b seeeduino_xiao_ble -- -DSHIELD=claude_code_pad \
#       -DZMK_EXTRA_MODULES="$PWD/src/ccp/claude-code-pad/firmware/zmk"
#
# The last -DZMK_EXTRA_MODULES flag is what lets ZMK find our shield
# definition under boards/shields/claude_code_pad/ without having to
# clone the shield into zmk/app/boards/shields/ itself.
#
# REVISION PINS (Phase 3 Cycle 2 -- RED-FW BLOCKER #15 / FW-M10):
#   zmk  -> 0331b7d16e80954b807917f9323e59ffc1e3b626 (main HEAD 2026-04-15)
#   Zephyr is imported transitively from zmk/app/west.yml which pins
#   zephyrproject-rtos/zephyr @ v4.1.0+zmk-fixes tag -- we do NOT
#   override that here (ZMK tracks Zephyr-with-patches separately and
#   overriding its Zephyr pin breaks the RGB underglow driver).
#
# Bumping pins: update the `revision:` below, rebuild, verify
# ccp_safety still compiles, then amend this header with the new sha.

manifest:
  remotes:
    - name: zmkfirmware
      url-base: https://github.com/zmkfirmware

  projects:
    - name: zmk
      remote: zmkfirmware
      revision: 0331b7d16e80954b807917f9323e59ffc1e3b626
      import: app/west.yml

  self:
    path: config
```

## claude-code-pad/firmware/zmk/drivers/ccp_safety/Kconfig
```kconfig
# Copyright (c) 2026 Claude Code Pad project
# SPDX-License-Identifier: MIT

menuconfig CCP_BATTERY_GUARD
	bool "Claude Code Pad battery guard (VBAT monitoring + undervolt cutoff)"
	depends on ADC && ZMK_RGB_UNDERGLOW
	default n
	help
	  Samples VBAT via the nRF52840 SAADC and enforces the
	  3.80 V (LEDs-on) / 3.50 V (LEDs-off) graceful-shutdown cutoff
	  from firmware/zmk/README.md, and derates the RGB underglow
	  linearly from 4.00 V -> 3.80 V. Implements broken-wire detection
	  per the same README (max-deviation > 100 mV or step > 0.3 V over
	  two consecutive 8-sample windows -> same shutdown path).

if CCP_BATTERY_GUARD

config CCP_BATTERY_GUARD_SAMPLE_INTERVAL_MS
	int "VBAT sample interval (ms)"
	default 250
	range 50 2000
	help
	  Sample cadence for VBAT_ADC. Phase 3 Cycle 2 brought this down
	  from 10 s to 250 ms per RED-SAFETY SF-B3: the nRF52840 brownout
	  at 1.7 V plus 400 mV LDO ESR sag can traverse the cutoff band
	  faster than a 10 s poll. 250 ms catches any plausible cell-sag
	  event within one cycle while still drawing negligible average
	  current at ~50 uA per burst sample.

config CCP_BATTERY_GUARD_STACK_SIZE
	int "Battery guard work stack size"
	default 1024

config CCP_BATTERY_GUARD_INIT_PRIORITY
	int "Battery guard init priority"
	default 91
	help
	  Runs AFTER the WS2812 / ZMK RGB driver (priority 90) so it can
	  register a brightness clamp as soon as RGB is up. Kept as a
	  plain int (not GPIO_INIT_PRIORITY + N) because the SYS_INIT
	  group is APPLICATION, which runs after all driver init phases.

endif # CCP_BATTERY_GUARD

menuconfig CCP_THERMAL_GUARD
	bool "Claude Code Pad thermal guard (NTC monitoring + RGB cap fallback)"
	depends on ADC && ZMK_RGB_UNDERGLOW
	default n
	help
	  Samples NTC_ADC at boot and every 2 s. If the reading is outside
	  0.1 V .. 3.1 V (broken-wire / floating pin) OR if the decoded
	  temperature exceeds CCP_THERMAL_GUARD_OVERTEMP_C, clamps the
	  effective RGB cap to 100 mA (~33 % of the 300 mA Annex Q cap)
	  per firmware/zmk/README.md §Hard Requirement: NTC fallback.

if CCP_THERMAL_GUARD

config CCP_THERMAL_GUARD_SAMPLE_INTERVAL_MS
	int "NTC sample interval (ms)"
	default 2000
	range 500 30000
	help
	  Phase 3 Cycle 2 drops this from 30 s to 2 s so that the TTL
	  watchdog in the cap registry (2 * sample interval) triggers
	  fail-dark within 4 s of any guard-thread hang.

config CCP_THERMAL_GUARD_OVERTEMP_C
	int "RGB-derate trigger temperature (degC)"
	default 50
	range 30 90
	help
	  Phase 3 Cycle 2 dropped the default from 60 degC to 50 degC
	  (SF-M9). The NTC in this PCB revision is co-located with the
	  LDO on the XIAO, not the cell; the correlation factor to cell
	  surface is unverified. A 10 degC cushion keeps the cell well
	  below the 60 degC IEC 62133-2 onset threshold even under the
	  worst-case measurement-delta scenario.

config CCP_THERMAL_GUARD_INIT_PRIORITY
	int "Thermal guard init priority"
	default 92

endif # CCP_THERMAL_GUARD

config CCP_RGB_INIT_SAFE
	bool "Pre-RGB-driver GPIO LOW hook (DIN pre-drive)"
	depends on ZMK_RGB_UNDERGLOW
	default y
	help
	  Drives RGB_DIN_MCU (P0.06) LOW at SYS_INIT priority 45 before
	  the WS2812 driver initialises, so the LEDs cannot see garbage
	  on DIN at power-on.

config CCP_PAIR_BEHAVIOR
	bool "Claude Code Pad time-bounded pairing-mode behavior"
	depends on BT
	default y
	help
	  Provides the &ccp_pair behavior used by the keymap to flip
	  bt_set_bondable(true) for 60 s when the user holds the
	  BT-layer BT0 chord for 3 s. With CONFIG_BT_BONDABLE=n as the
	  shipped default, this is the ONLY way new bonds can form -- so
	  it must remain enabled in any release build that exposes BLE
	  HID. Disabling it means the device cannot pair out of the box;
	  only useful for hostile-recompile experimentation per
	  firmware/zmk/README.md §scope-boundary.

	  Closes RED-SAFETY SF-M12.
```

## claude-code-pad/firmware/zmk/dts/bindings/behaviors/zmk,behavior-ccp-pair.yaml
```yaml
# Copyright (c) 2026 Claude Code Pad project
# SPDX-License-Identifier: MIT
#
# Devicetree binding for the Claude Code Pad pairing-window behavior.
#
# When pressed, ccp_pair calls bt_set_bondable(true), schedules a
# 60-second k_work_delayable that re-asserts bt_set_bondable(false),
# and starts a 1 Hz LED-25 blink for the duration of the window.
# Calling the behavior again before the window expires resets the
# 60-second timer (no toggle / no early-cancel; this is by design --
# accidental presses must not LEAVE the device bondable indefinitely
# but must not silently cancel an in-progress pair either).
#
# Closes RED-SAFETY SF-M12: with CONFIG_BT_BONDABLE=n the device cannot
# pair out of the box; ccp_pair is the explicit, time-bounded window
# during which a host can establish a bond.

description: Claude Code Pad bondable pairing-window behavior

compatible: "claude-code-pad,behavior-ccp-pair"

include: zero_param.yaml
```

## claude-code-pad/firmware/zmk/dts/bindings/claude-code-pad,ccp-safety.yaml
```yaml
# Copyright (c) 2026 Claude Code Pad project
# SPDX-License-Identifier: MIT
#
# Devicetree binding for the Claude Code Pad combined safety node.
#
# Exposes two ADC channels (VBAT divider + NTC), the divider ratio
# needed to recover the cell voltage, and the NTC thermistor B-value
# and series-pull-up resistance used by ccp_thermal_guard.

description: |
  Claude Code Pad ccp-safety aggregator node. Provides the SAADC
  channel handles (vbat, ntc) and the scaling constants the safety
  driver suite needs to convert raw ADC readings to millivolts-at-cell
  (for VBAT) and degC (for NTC). Not a real hardware block -- a
  zephyr,device-subsystem-less glue node that holds the runtime
  constants in one place so they are reviewable in DT rather than
  scattered as #defines across the driver C code.

compatible: "claude-code-pad,ccp-safety"

include: base.yaml

properties:
  io-channels:
    type: phandle-array
    required: true
    description: |
      Ordered SAADC channel references. Index 0 is the VBAT divider
      tap, index 1 is the NTC divider tap. io-channel-names must
      include "vbat" and "ntc" aligned with this order.

  io-channel-names:
    type: string-array
    required: true
    description: |
      Must be exactly ["vbat", "ntc"] in that order. The driver
      suite looks up channels by name but also requires the index
      ordering for DT_SPEC_GET_BY_IDX compatibility.

  vbat-divider-ohms:
    type: array
    required: true
    description: |
      Two-element array [R_high_ohm, R_low_ohm] describing the VBAT
      resistor divider. The ADC pin sits at the centre tap; cell
      voltage is recovered by (R_high + R_low) / R_low. For the
      Claude Code Pad both legs are 1 MOhm -> multiplier 2.

  ntc-beta-k:
    type: int
    required: true
    description: |
      NTC thermistor B-constant in Kelvin. MF52 10 kOhm B=3950 is
      the stocked part; this property lets substitutes be swapped
      in without driver rebuild.

  ntc-pullup-ohms:
    type: int
    required: true
    description: |
      Series resistor on the low side of the NTC divider (R_NTC).
      10 kOhm nominal -- swapping to 100 kOhm extends the sensitive
      range into colder temperatures but requires a driver cap
      recalc.

  ntc-nominal-ohms:
    type: int
    default: 10000
    description: |
      NTC resistance at nominal temperature (typically 10 kOhm at
      25 degC). Used together with ntc-beta-k in the B-parameter
      equation.

  ntc-nominal-temp-k:
    type: int
    default: 298
    description: |
      Nominal temperature (in Kelvin) at which ntc-nominal-ohms
      applies. 298 K = 25 degC. Integer-rounded from 298.15.
```

## claude-code-pad/firmware/zmk/tests/ccp_safety/testcase.yaml
```yaml
# Copyright (c) 2026 Claude Code Pad project
# SPDX-License-Identifier: MIT

tests:
  ccp_safety.cap_registry:
    platform_allow:
      - native_sim
      - native_sim/native/64
      - native_posix
    tags:
      - safety
      - ccp_safety
    harness: ztest
```
