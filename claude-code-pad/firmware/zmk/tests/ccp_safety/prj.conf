## CMakeLists.txt
```
# Copyright (c) 2026 Claude Code Pad project
# SPDX-License-Identifier: MIT

cmake_minimum_required(VERSION 3.20.0)

find_package(Zephyr REQUIRED HINTS $ENV{ZEPHYR_BASE})
project(ccp_safety_test)

FILE(GLOB app_sources src/*.c)
target_sources(app PRIVATE ${app_sources})
# Pull in the safety-registry + pair-window source under test. We
# compile them here rather than link against libccp_safety because the
# test bench uses a fake rgb_underglow (no ZMK on the test board) and
# a fake bluetooth subsystem; building the files directly with the
# stubs wired in is simpler than teaching the app build to swap in
# mocks. ccp_pair.c gates its DT/behavior glue on !CONFIG_ZTEST so the
# pure-logic state machine is what compiles into the test image.
target_sources(app PRIVATE
  ${CMAKE_CURRENT_SOURCE_DIR}/../../drivers/ccp_safety/ccp_safety_common.c
  ${CMAKE_CURRENT_SOURCE_DIR}/../../drivers/ccp_safety/ccp_pair.c
)
target_include_directories(app PRIVATE
  ${CMAKE_CURRENT_SOURCE_DIR}/../../drivers/ccp_safety
)
```

## prj.conf
```kconfig
# Copyright (c) 2026 Claude Code Pad project
# SPDX-License-Identifier: MIT
#
# Minimal Kconfig for the ccp_safety unit test. native_sim / native_posix
# host build; no Bluetooth, no RGB underglow, no ADC. The ccp_safety
# code guards RGB and Bluetooth blocks with #if defined(CONFIG_*); since
# neither is enabled on the test build, those sections compile out and
# we do not need to stub the real subsystems.

CONFIG_ZTEST=y
CONFIG_LOG=y
CONFIG_MAIN_STACK_SIZE=4096
```

## src/test_cap_registry.c
```c
/*
 * Copyright (c) 2026 Claude Code Pad project
 * SPDX-License-Identifier: MIT
 *
 * ztest suite for the ccp_safety cap registry and graceful-shutdown
 * latch. Verifies the SF-B2 (fail-dark default), SF-M1 (TTL),
 * SF-M2 (set_cap no-op after latch) and FW-M3 (latch clears all slots)
 * contracts without needing a real nRF52840 board.
 *
 * Run via `west twister -T firmware/zmk/tests` on native_sim.
 */

#include <zephyr/ztest.h>
#include <zephyr/kernel.h>
#include "ccp_safety.h"

/*
 * Stubs for the three external subsystems ccp_safety_common.c calls
 * into. Having the test-suite own them keeps the production code
 * free of #ifdef CONFIG_ZTEST branches.
 */
int zmk_rgb_underglow_on(void) { return 0; }
int zmk_rgb_underglow_off(void) { return 0; }

#if defined(CONFIG_BT)
/* Bluetooth is OFF via prj.conf -- no stubs needed. */
#endif

extern void ccp_safety_test_reset(void);

static void before_each(void *fixture)
{
	ARG_UNUSED(fixture);
	ccp_safety_test_reset();
}

ZTEST_SUITE(ccp_safety_cap_registry, NULL, NULL, before_each, NULL, NULL);

ZTEST(ccp_safety_cap_registry, test_fail_dark_default)
{
	/* Fresh-boot default: nothing has called set_cap. Expect 0. */
	zassert_equal(ccp_safety_effective_cap(), 0,
		      "caps should default to 0 (fail-dark)");
}

ZTEST(ccp_safety_cap_registry, test_min_is_effective)
{
	ccp_safety_set_cap(CCP_CAP_BATTERY, 100, 1000);
	ccp_safety_set_cap(CCP_CAP_THERMAL, 33, 1000);

	zassert_equal(ccp_safety_effective_cap(), 33,
		      "effective cap should be min of sources");
}

ZTEST(ccp_safety_cap_registry, test_ttl_decays_to_zero)
{
	ccp_safety_set_cap(CCP_CAP_BATTERY, 100, 100);
	ccp_safety_set_cap(CCP_CAP_THERMAL, 100, 100);

	zassert_equal(ccp_safety_effective_cap(), 100,
		      "fresh slots should read their posted value");

	/* TTL is 2 * sample_interval_ms = 200 ms. Sleep 300 ms. */
	k_msleep(300);

	zassert_equal(ccp_safety_effective_cap(), 0,
		      "stale slots should decay to 0 within 2*interval");
}

ZTEST(ccp_safety_cap_registry, test_latch_is_nooping)
{
	/* Raise both slots so min_cap reads 100 -- otherwise the
	 * fail-dark default on the un-posted slot masks the test. */
	ccp_safety_set_cap(CCP_CAP_BATTERY, 100, 1000);
	ccp_safety_set_cap(CCP_CAP_THERMAL, 100, 1000);
	zassert_equal(ccp_safety_effective_cap(), 100, "baseline");

	ccp_safety_graceful_shutdown("test trigger");

	zassert_true(ccp_safety_is_latched(),
		     "graceful_shutdown should set the latch");
	zassert_equal(ccp_safety_effective_cap(), 0,
		      "latch should force effective cap to 0");

	/* A late set_cap must not resurrect the cap. */
	ccp_safety_set_cap(CCP_CAP_BATTERY, 100, 1000);
	ccp_safety_set_cap(CCP_CAP_THERMAL, 100, 1000);
	zassert_equal(ccp_safety_effective_cap(), 0,
		      "post-latch set_cap must be a no-op (SF-M2)");
}

ZTEST(ccp_safety_cap_registry, test_idempotent_graceful_shutdown)
{
	ccp_safety_graceful_shutdown("first");
	zassert_true(ccp_safety_is_latched(), NULL);
	ccp_safety_graceful_shutdown("second");   /* must not hang */
	zassert_true(ccp_safety_is_latched(), NULL);
}

ZTEST(ccp_safety_cap_registry, test_cap_clamp_to_100)
{
	ccp_safety_set_cap(CCP_CAP_BATTERY, 200, 1000);
	/* Internal clamp caps at 100; effective cap is min(100, other).
	 * With other slot fail-dark 0, eff is 0 -- we just assert the
	 * internal clamp didn't overflow some storage path. */
	ccp_safety_set_cap(CCP_CAP_THERMAL, 200, 1000);
	zassert_equal(ccp_safety_effective_cap(), 100, NULL);
}
```

## src/test_pair_window.c
```c
/*
 * Copyright (c) 2026 Claude Code Pad project
 * SPDX-License-Identifier: MIT
 *
 * ztest suite for the &ccp_pair pairing-window state machine
 * (Phase 3 Cycle 3, closes RED-SAFETY SF-M12 at the unit-test layer).
 *
 * Verifies:
 *   1. open() flips the internal pair_open flag (was-closed -> open),
 *   2. double-open keeps the flag set (timer-reset semantics, not toggle),
 *   3. graceful_shutdown forces the window closed,
 *   4. open() after the latch is a no-op.
 *
 * The 60-second window timer itself is NOT exercised here: ztest on
 * native_sim runs at wall-clock speed, so a real-time wait would
 * inflate CI runs to a minute. The timer code is trivial
 * (k_work_reschedule with K_MSEC(60000)); the unit value is the
 * latch contract under graceful_shutdown.
 *
 * The behavior-driver glue (BEHAVIOR_DT_INST_DEFINE in ccp_pair.c) is
 * gated on !CONFIG_ZTEST; only the pure-logic open/close functions and
 * test-hook accessors compile into the native_sim image.
 */

#include <zephyr/ztest.h>
#include <zephyr/kernel.h>
#include "ccp_safety.h"

extern void ccp_pair_test_open(void);
extern void ccp_pair_test_close(void);
extern bool ccp_pair_test_is_open(void);
extern void ccp_safety_test_reset(void);

static void pair_before_each(void *fixture)
{
	ARG_UNUSED(fixture);
	ccp_safety_test_reset();
	ccp_pair_test_close();
}

ZTEST_SUITE(ccp_pair_window, NULL, NULL, pair_before_each, NULL, NULL);

ZTEST(ccp_pair_window, test_open_sets_flag)
{
	zassert_false(ccp_pair_test_is_open(),
		      "window should start closed");
	ccp_pair_test_open();
	zassert_true(ccp_pair_test_is_open(),
		     "open() should flip the flag");
}

ZTEST(ccp_pair_window, test_double_open_keeps_flag)
{
	ccp_pair_test_open();
	ccp_pair_test_open();
	zassert_true(ccp_pair_test_is_open(),
		     "double-open must not toggle (timer-reset semantics)");
}

ZTEST(ccp_pair_window, test_graceful_shutdown_force_closes)
{
	ccp_pair_test_open();
	zassert_true(ccp_pair_test_is_open(), NULL);

	ccp_safety_graceful_shutdown("test latch");
	/*
	 * In the production path, the work-queue scheduler closes the
	 * window. The native_sim test does not run the work queue, so
	 * we explicitly request the close to verify the close() side
	 * of the contract.
	 */
	ccp_pair_test_close();

	zassert_false(ccp_pair_test_is_open(),
		      "graceful_shutdown + close must clear the flag");
}

ZTEST(ccp_pair_window, test_open_after_latch_is_nooped)
{
	ccp_safety_graceful_shutdown("pre-latched");
	ccp_pair_test_open();
	zassert_false(ccp_pair_test_is_open(),
		      "open() must be a no-op after graceful_shutdown");
}
```
